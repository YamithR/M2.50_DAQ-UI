## firmware/main/Kconfig.projbuild
```kconfig
menu "M2 DAQ Configuration"

    config M2_WIFI_SSID
        string "WiFi SSID"
        default "M2-DAQ_AP"
        help
            SSID of the WiFi network the ESP32-S3 will connect to (STA mode).
            Can be overridden at runtime via POST /api/config.

    config M2_WIFI_PASSWORD
        string "WiFi Password"
        default ""
        help
            WPA2 password. Leave empty for open networks.

    config M2_HOSTNAME
        string "mDNS Hostname"
        default "m2daq"
        help
            The ESP32 will be reachable at http://<hostname>.local/ once mDNS
            is active. Also used as the BLE advertised device name prefix.

    config M2_HTTP_PORT
        int "HTTP Server Port"
        default 80
        range 1 65535
        help
            TCP port for the web server. Default 80 requires no port in the URL.

endmenu
```

## firmware/sdkconfig.defaults
```kconfig
# Target
CONFIG_IDF_TARGET="esp32s3"

# USB OTG / TinyUSB — required for HID mouse
CONFIG_TINYUSB_ENABLED=y
CONFIG_TINYUSB_HID_ENABLED=y

# NimBLE Bluetooth (coexists with WiFi on ESP32-S3)
CONFIG_BT_ENABLED=y
CONFIG_BT_NIMBLE_ENABLED=y
CONFIG_BT_NIMBLE_MAX_CONNECTIONS=2
CONFIG_BT_NIMBLE_ROLE_PERIPHERAL=y
CONFIG_BT_NIMBLE_ROLE_OBSERVER=n

# WiFi
CONFIG_ESP_WIFI_STATIC_RX_BUFFER_NUM=4
CONFIG_ESP_WIFI_DYNAMIC_RX_BUFFER_NUM=8

# HTTP server — increase URI handler limit for REST API
CONFIG_HTTPD_MAX_URI_HANDLERS=12
CONFIG_HTTPD_MAX_RESP_HEADERS=10
CONFIG_HTTPD_WS_SUPPORT=y

# SPIFFS
CONFIG_SPIFFS_MAX_PARTITIONS=1
CONFIG_SPIFFS_OBJ_NAME_LEN=64

# FreeRTOS
CONFIG_FREERTOS_HZ=1000
CONFIG_ESP_MAIN_TASK_STACK_SIZE=8192

# Flash / Partition
CONFIG_PARTITION_TABLE_CUSTOM=y
CONFIG_PARTITION_TABLE_CUSTOM_FILENAME="partitions.csv"

# PCNT (pulse counter) — required for encoder driver
CONFIG_PCNT_ENABLE_DEBUG_LOG=n

# Logging
CONFIG_LOG_DEFAULT_LEVEL_INFO=y
```
